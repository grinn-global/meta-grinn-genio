## meta-grinn-genio-bsp/conf/machine/grinn-genio-510-sbc.conf
```bitbake
require include/soms/grinn-genio-510-som.inc
require include/platforms/grinn-genio-510-700-sbc.inc

MACHINEOVERRIDES =. "mt8370-evk:"

FWUPDATE_TFA_ID = "9d78dc91-dc86-477a-80e5-07fe69e84e27"
FWUPDATE_FIP_ID = "85e51a98-4c96-4b96-bd18-273619586891"
```

## meta-grinn-genio-bsp/conf/machine/grinn-genio-700-evb.conf
```bitbake
require include/soms/grinn-genio-700-som.inc
require include/platforms/grinn-genio-platform.inc
require conf/machine/include/mt7921.inc

MACHINEOVERRIDES =. "mt8390-evk:"

FWUPDATE_TFA_ID = "25347ba5-38a0-43a6-8633-57fa53129616"
FWUPDATE_FIP_ID = "f3ddc842-be64-45b0-8ab7-b34fe40729f0"

MACHINE_FEATURES:append = " alsa bluetooth pci usbgadget usbhost wifi tsn uc-fde"

ONSEMI_BOARD_NAME = "MediaTek_Genio"
MACHINE_EXTRA_RRECOMMENDS:append = " \
        onsemi-firmware-ap1302-ar0430 \
        onsemi-firmware-ap1302-ar0830 \
"

MACHINE_EXTRA_RRECOMMENDS:append = " \
        ite-it6510-driver \
        lontium-lt6911-driver \
"

PACKAGECONFIG:append:pn-networkmanager = " modemmanager"

KERNEL_DEVICETREE_OVERLAYS_AUTOLOAD ?= "video.dtbo apusys.dtbo display-hdmi.dtbo display-dp.dtbo"
```

## meta-grinn-genio-bsp/conf/machine/grinn-genio-700-sbc.conf
```bitbake
require include/soms/grinn-genio-700-som.inc
require include/platforms/grinn-genio-510-700-sbc.inc

MACHINEOVERRIDES =. "mt8390-evk:"

FWUPDATE_TFA_ID = "b85b3c89-c237-4f4f-98ca-14d5d5e2678e"
FWUPDATE_FIP_ID = "b1566e64-0418-4e5b-a8b6-edf1e36f42b2"
```

## meta-grinn-genio-bsp/conf/machine/include/platforms/grinn-genio-510-700-sbc.inc
```bitbake
require grinn-genio-platform.inc
require conf/machine/include/mt7921.inc 

MACHINEOVERRIDES =. "grinn-genio-510-700-sbc:"

MACHINE_FEATURES:append = " alsa bluetooth pci usbgadget usbhost wifi tsn uc-fde"

ONSEMI_BOARD_NAME = "MediaTek_Genio"
MACHINE_EXTRA_RRECOMMENDS:append = " \
        onsemi-firmware-ap1302-ar0430 \
        onsemi-firmware-ap1302-ar0830 \
"

MACHINE_EXTRA_RRECOMMENDS:append = " \
        i2c-utils-optiga-trust \
	python3-dev \
"

MACHINE_EXTRA_RRECOMMENDS:append = " \
    ${@bb.utils.contains( \
        'MACHINE_FEATURES', \
        'deepx', \
        ' dx-driver dx-rt dx-stream dx-stream-sample', \
        '', \
        d \
    )} \
"

MACHINE_EXTRA_RRECOMMENDS:append = " \
        bluez5 \
        firmware-nxp-wifi-nxp8987-sdio \
"
```

## meta-grinn-genio-bsp/conf/machine/include/platforms/grinn-genio-platform.inc
```bitbake
MACHINEOVERRIDES =. "grinn-genio-platform:"

KERNEL_DEVICETREE = "mediatek/${MACHINE}.dtb"

IMAGE_FSTYPES:append = " aiotflash.tar.zst aiotflash.tar.zst.sha256sum tar.zst"

do_image_aiotflash[depends] += "virtual/dtb:do_deploy"
EXTRA_IMAGEDEPENDS += "virtual/dtb"
IMAGE_CMD:aiotflash:append () {
    cp -a ${DEPLOY_DIR_IMAGE}/devicetree ${tmp_pack_dir}/
}

IMAGE_CMD:aiotflash:append () {
    rm -v -f ${tmp_pack_dir}/partitions.json
    cp -v -L ${tmp_pack_dir}/rity.json ${tmp_pack_dir}/partitions.json
}

IMAGE_CMD:aiotflash:append () {
    cp -v -L ${DEPLOY_DIR_IMAGE}/fw_env.config ${tmp_pack_dir}/
}
```

## meta-grinn-genio-bsp/conf/machine/include/soms/grinn-genio-510-700-som.inc
```bitbake
MACHINEOVERRIDES =. "grinn-genio-510-700-som:"

OPTEE_DRAM_SIZE = "0x200000000"
LIBDRAM_BOARD_NAME = "genio-700-evk"
```

## meta-grinn-genio-bsp/conf/machine/include/soms/grinn-genio-510-som.inc
```bitbake
require conf/machine/include/mt8370.inc
require grinn-genio-510-700-som.inc

MACHINEOVERRIDES =. "grinn-genio-510-som:"
LK_BOARD_NAME = "genio-510-evk"
UBOOT_MACHINE = "genio_510_evk_defconfig"
```

## meta-grinn-genio-bsp/conf/machine/include/soms/grinn-genio-700-som.inc
```bitbake
require conf/machine/include/mt8188.inc
require grinn-genio-510-700-som.inc

MACHINEOVERRIDES =. "grinn-genio-700-som:"
LK_BOARD_NAME = "genio-700-evk"
UBOOT_MACHINE = "genio_700_evk_defconfig"
```
