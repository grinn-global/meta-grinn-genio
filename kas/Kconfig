## kas/Kconfig
```kconfig
mainmenu "Grinn Genio"

config KAS_BUILD_SYSTEM
	string
	default "openembedded"

choice
	prompt "Machine"
	help
	  Yocto machine to build the image for. Only the extensions supported
	  by the selected machine are shown in the menu.

config MACHINE_GRINN_GENIO_510_SBC
	bool "grinn-genio-510-sbc"

config MACHINE_GRINN_GENIO_700_SBC
	bool "grinn-genio-700-sbc"

config MACHINE_GRINN_GENIO_360_360P_SBC
	bool "grinn-genio-360-360p-sbc"

endchoice

config MACHINE
	string
	default "grinn-genio-510-sbc" if MACHINE_GRINN_GENIO_510_SBC
	default "grinn-genio-700-sbc" if MACHINE_GRINN_GENIO_700_SBC
	default "grinn-genio-360-360p-sbc" if MACHINE_GRINN_GENIO_360_360P_SBC

comment "Image Configuration"

config KAS_INCLUDE_DEFAULT
	string
	default "kas/default.yml"

config NDA
	bool "NDA extension"
	help
	  Adds components covered by the Non-Disclosure Agreement (NDA) with
	  MediaTek. See the Yocto Feature Table for the full list:
	  https://download.mediatek.com/aiot/download/release-note/v26.0/v26.0_IoT_Yocto_Scarthgap_Feature_Table_v1.0.pdf

	  Building requires access to the MediaTek NDA repositories. Configure
	  the git credentials with genio-account-setup.py, as described in the
	  Git01 Setup Guide:
	  https://mediatek.gitlab.io/aiot/doc/aiot-dev-guide/master/sw/yocto/get-started/account-setup.html
	  and run kas-container with NETRC_FILE=~/.netrc.

config KAS_INCLUDE_NDA
	string
	default "kas/nda.yml"
	depends on NDA

config DEEPX
	bool "DEEPX extension"
	help
	  Adds support for DEEPX DX-M1 AI inference accelerators.

config KAS_INCLUDE_DEEPX
	string
	default "kas/deepx.yml"
	depends on DEEPX

config DEMO
	bool "Demo extension"
	help
	  Adds demo applications to showcase the capabilities of the hardware.

config KAS_INCLUDE_DEMO
	string
	default "kas/demo.yml"
	depends on DEMO

menuconfig NETBOOT
	bool "Netboot extension"
	help
	  Configures U-Boot to load the kernel over TFTP and mount the root
	  filesystem over NFS from the build host. The board must be flashed
	  once with this image.

if NETBOOT

config KAS_INCLUDE_NETBOOT
	string
	default "kas/netboot.yml"

config NETBOOT_SERVER_IP
	string "Netboot server IP address"
	default "$(NETBOOT_SERVER_IP)"
	help
	  IP address of the host running the TFTP and NFS servers, as seen
	  from the board. Required: the build fails if it is empty. To find
	  it, run on the host:

	    ip -4 route get 1.1.1.1 | awk '{print $7}'

	  Defaults to the NETBOOT_SERVER_IP environment variable, if set.

config NETBOOT_SERVER_SUBDIR
	string "Netboot server subdirectory"
	default "$(NETBOOT_SERVER_SUBDIR)"
	help
	  Subdirectory of the TFTP and NFS roots holding the boot files, for
	  example your user name (output of "whoami"). It must match the
	  --subdir argument of the netboot sync script. Required: the build
	  fails if it is empty.

	  Defaults to the NETBOOT_SERVER_SUBDIR environment variable, if set.

endif
```

## meta-grinn-genio-bsp/conf/machine/grinn-genio-360-360p-sbc.conf
```bitbake
require include/soms/grinn-genio-360-360p-som.inc
require include/platforms/grinn-genio-platform.inc
require conf/machine/include/mt7921.inc

MACHINEOVERRIDES =. "mt8366-evk:"

FWUPDATE_TFA_ID = "c150712c-1233-45d6-bddb-01e9ede587e1"
FWUPDATE_FIP_ID = "0fb81cb5-135a-4c4f-8373-6933c83a71cb"

KERNEL_DEVICETREE = "mediatek/grinn-genio-360-sbc.dtb \
                     mediatek/grinn-genio-360p-sbc.dtb"

UBOOT_CHIP_DTB_MAP = "mt8366:mediatek/grinn-genio-360-sbc.dtb \
                      mt8367:mediatek/grinn-genio-360p-sbc.dtb"

MACHINE_FEATURES:append = " alsa bluetooth pci usbgadget usbhost wifi tsn uc-fde"

ONSEMI_BOARD_NAME = "MediaTek_Genio"
MACHINE_EXTRA_RRECOMMENDS:append = " \
        onsemi-firmware-ap1302-ar0430 \
        onsemi-firmware-ap1302-ar0830 \
"

MACHINE_EXTRA_RRECOMMENDS:append = " \
        i2c-utils-optiga-trust \
        python3-dev \
"

MACHINE_EXTRA_RRECOMMENDS:append = " \
    ${@bb.utils.contains( \
        'MACHINE_FEATURES', \
        'deepx', \
        ' dx-driver dx-rt dx-stream dx-stream-sample', \
        '', \
        d \
    )} \
"

MACHINE_EXTRA_RRECOMMENDS:append = " \
        bluez5 \
"

KERNEL_DEVICETREE_OVERLAYS_AUTOLOAD ?= "video.dtbo apusys.dtbo display-dp.dtbo"
```
