/dts-v1/;
#include "mt8370.dtsi"
#include "grinn-genio-510-700-sbc.dtsi"

/ {
	model = "Grinn GenioSBC-510";
	compatible = "grinn,genio-510-sbc", "mediatek,mt8370", "mediatek,mt8188";
};

&sound {
	model = "mt8370-evk";
};
