// SPDX-License-Identifier: GPL-2.0 OR MIT
/*
 * Copyright (C) 2023 MediaTek Inc.
 * Copyright (C) 2025-2026 Grinn sp. z o.o.
 */

/dts-v1/;

#include <config.h>

#include "mt8370.dtsi"
#include "grinn-genio-510-700-som.dtsi"
#include "grinn-genio-510-700-sbc.dtsi"

/ {
	model = "Grinn GenioSBC-510";
	compatible = "grinn,genio-510-sbc", "mediatek,mt8370";
};
