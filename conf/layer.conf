## conf/layer.conf
```bitbake
# We have a conf and classes directory, add to BBPATH
BBPATH .= ":${LAYERDIR}"

# We have recipes-* directories, add to BBFILES
BBFILES += "${LAYERDIR}/recipes-*/*/*.bb \
            ${LAYERDIR}/recipes-*/*/*.bbappend"

BBFILE_COLLECTIONS += "grinn-genioboard"
BBFILE_PATTERN_grinn-genioboard = "^${LAYERDIR}/"
BBFILE_PRIORITY_grinn-genioboard = "10"

LAYERVERSION_grinn-genioboard = "1"

LAYERDEPENDS_grinn-genioboard = " \
	core \
"

LAYERSERIES_COMPAT_grinn-genioboard = " kirkstone "
```

## conf/local.conf.sample
```bitbake
MACHINE ??= "grinn-genio-700-evb"
DISTRO ?= "rity-demo"
PACKAGE_CLASSES ?= "package_ipk"
EXTRA_IMAGE_FEATURES ?= "debug-tweaks"
USER_CLASSES ?= "buildstats"
PATCHRESOLVE = "noop"
BB_DISKMON_DIRS ??= "\
    STOPTASKS,${TMPDIR},1G,100K \
    STOPTASKS,${DL_DIR},1G,100K \
    STOPTASKS,${SSTATE_DIR},1G,100K \
    STOPTASKS,/tmp,100M,100K \
    HALT,${TMPDIR},100M,1K \
    HALT,${DL_DIR},100M,1K \
    HALT,${SSTATE_DIR},100M,1K \
    HALT,/tmp,10M,1K"
PACKAGECONFIG:append:pn-qemu-system-native = " sdl"
SKIP_META_SECURITY_SANITY_CHECK = "1"
CONF_VERSION = "2"
LICENSE_FLAGS_ACCEPTED = "commercial"
IMAGE_ROOTFS_EXTRA_SPACE = "200000"
KERNEL_DEVICETREE_OVERLAYS_AUTOLOAD:genio-700 += "gpu-mali.dtbo video.dtbo apusys.dtbo"
```

## conf/machine/grinn-genio-510-sbc.conf
```bitbake
#@TYPE: Machine
#@NAME: Grinn GenioSBC-510
#@DESCRIPTION: Machine configuraion for Grinn GenioSBC-510

require conf/machine/include/mt8370.inc
require conf/machine/include/mt7921.inc

# Kernel
KERNEL_DEVICETREE = "mediatek/grinn-genio-510-sbc.dtb"

# U-Boot
UBOOT_MACHINE = "genio_510_evk_defconfig"

# libdram
LIBDRAM_BOARD_NAME = "genio-700-evk"

# OP-TEE
OPTEE_DRAM_SIZE = "0x200000000"

# LK
LK_BOARD_NAME = "${LIBDRAM_BOARD_NAME}"

MACHINE_FEATURES:append = " alsa bluetooth pci usbgadget usbhost wifi tsn uc-fde"

# Only required for mt8370-evk.conf
MACHINEOVERRIDES =. "mt8370-evk:grinn-genio-sbc:"

# onsemi-firmware
ONSEMI_BOARD_NAME = "MediaTek_Genio"
MACHINE_EXTRA_RRECOMMENDS:append = " \
        onsemi-firmware-ap1302-ar0430 \
        onsemi-firmware-ap1302-ar0830 \
"

FWUPDATE_TFA_ID = "9d78dc91-dc86-477a-80e5-07fe69e84e27"
FWUPDATE_FIP_ID = "85e51a98-4c96-4b96-bd18-273619586891"

IMAGE_INSTALL:append = "i2c-utils-optiga-trust python3-dev"
```

## conf/machine/grinn-genio-700-evb.conf
```bitbake
#@TYPE: Machine
#@NAME: Grinn GenioEVB-700
#@DESCRIPTION: Machine configuration for the Grinn GenioEVB-700

include conf/machine/genio-700-evk.conf

MACHINEOVERRIDES =. "genio-700-evk:"

KERNEL_DEVICETREE = "mediatek/grinn-genio-700-evb.dtb"

FWUPDATE_TFA_ID = "25347ba5-38a0-43a6-8633-57fa53129616"

FWUPDATE_FIP_ID = "f3ddc842-be64-45b0-8ab7-b34fe40729f0"
```

## conf/machine/grinn-genio-700-sbc.conf
```bitbake
#@TYPE: Machine
#@NAME: Grinn GenioSBC-700
#@DESCRIPTION: Machine configuraion for Grinn GenioSBC-700

require conf/machine/include/mt8188.inc
require conf/machine/include/mt7921.inc

# Kernel
KERNEL_DEVICETREE = "mediatek/grinn-genio-700-sbc.dtb"

# U-Boot
UBOOT_MACHINE = "genio_700_evk_defconfig"

# libdram
LIBDRAM_BOARD_NAME = "genio-700-evk"

# OP-TEE
OPTEE_DRAM_SIZE = "0x200000000"

# LK
LK_BOARD_NAME = "${LIBDRAM_BOARD_NAME}"

MACHINE_FEATURES:append = " alsa bluetooth pci usbgadget usbhost wifi tsn uc-fde"

# Only required for mt8390-evk.conf
MACHINEOVERRIDES =. "mt8390-evk:"

# onsemi-firmware
ONSEMI_BOARD_NAME = "MediaTek_Genio"
MACHINE_EXTRA_RRECOMMENDS:append = " \
        onsemi-firmware-ap1302-ar0430 \
        onsemi-firmware-ap1302-ar0830 \
"

FWUPDATE_TFA_ID = "b85b3c89-c237-4f4f-98ca-14d5d5e2678e"
FWUPDATE_FIP_ID = "b1566e64-0418-4e5b-a8b6-edf1e36f42b2"

IMAGE_INSTALL:append = "i2c-utils-optiga-trust"
```

## conf/machine/grinn-genio.inc
```bitbake
IMAGE_FSTYPES = "wic.img aiotflash.tar.xz aiotflash.tar.xz.sha256sum"

#
# Use fast compression by default to reduce image assembly time.
# For releases where size is important it can be changed to Yocto default "-9"
#

XZ_COMPRESSION_LEVEL ?= "-3"
```
