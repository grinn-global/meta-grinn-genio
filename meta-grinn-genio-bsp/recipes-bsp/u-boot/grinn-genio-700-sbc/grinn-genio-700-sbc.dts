// SPDX-License-Identifier: GPL-2.0 OR MIT
/*
 * Copyright (C) 2022 MediaTek Inc.
 * Copyright (C) 2025-2026 Grinn sp. z o.o.
 */

/dts-v1/;

#include <config.h>

#include "mt8188.dtsi"
#include "grinn-genio-510-700-som.dtsi"
#include "grinn-genio-510-700-sbc.dtsi"

/ {
	model = "Grinn GenioSBC-700";
	compatible = "grinn,genio-700-sbc", "mediatek,mt8188";
};

&auxadc {
	status = "okay";
};
