// SPDX-License-Identifier: GPL-2.0
/*
 * Copyright (C) 2023 MediaTek Inc.
 * Copyright (C) 2026 Grinn sp. z o.o.
 */

/dts-v1/;
/plugin/;

#include "camera-common.dtsi"

/ {
	fragment@11 {
		target = <&i2c3>;

		__overlay__ {
			sensor1 {
				sensor-names = "imx214_mipi_raw";
				reg = <0x1a>;
				status = "okay";
			};
		};
	};

	fragment@12 {
		target = <&seninf_csi_port_1>;

		__overlay__ {
			status = "okay";
		};
	};

	fragment@13 {
		target = <&mtkcam0>;

		__overlay__ {
			status = "okay";
		};
	};
};
