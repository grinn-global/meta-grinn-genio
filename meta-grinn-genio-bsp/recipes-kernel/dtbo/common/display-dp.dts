// SPDX-License-Identifier: GPL-2.0
/*
 * Copyright (C) 2024 MediaTek Inc.
 * Copyright (C) 2026 Grinn sp. z o.o.
 */

/dts-v1/;
/plugin/;

/ {
	fragment@0 {
		target = <&dp_tx>;

		__overlay__ {
			status = "okay";
		};
	};

	fragment@1 {
		target = <&dp_intf1>;

		__overlay__ {
			status = "okay";
		};
	};

	fragment@2 {
		target = <&sound>;

		__overlay__ {
			dai-link-1 {
				status = "okay";
			};
		};
	};
};
